## target/linux/realtek/files/arch/mips/realtek/Kconfig
```kconfig
if REALTEK

menu "Realtek RLX based machine selection"

config REALTEK_MACH_GENERIC
	bool "Generic Realtek RLX based board"

config REALTEK_MACH_AU_HOME_SPOT_CUBE
	bool "AU HOME SPOT CUBE board"
	help
	  Say 'Y' here if you want your kernel to support the
	  AU HOME SPOT CUBE board.

config REALTEK_MACH_JWNR2000_V2
	bool "Netgear JWNR2000 v2 board"
	help
	  Say 'Y' here if you want to support the
	  Netgear JVNR2000 v2 board.

endmenu

endif
```
